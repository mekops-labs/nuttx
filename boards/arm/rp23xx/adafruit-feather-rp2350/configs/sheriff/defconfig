## boards/arm/rp23xx/pimoroni-pico-2-plus-w/Kconfig
```kconfig
#
# For a description of the syntax of this configuration file,
# see the file kconfig-language.txt in the NuttX tools repository.
#

if ARCH_BOARD_PIMORONI_PICO_2_PLUS_W

menuconfig RP23XX_INFINEON_CYW43439
	bool "Has Infineon cyw43439 WiFi chip"
	depends on IEEE80211_INFINEON_CYW43439
	default y
	---help---
		The Pimoroni Pico Plus 2 W has an onboard Raspberry Pi RM2 module
		(Infineon CYW43439 WiFi/BT chip) connected to the RP2350 via a
		PIO-based gSPI interface.

endif

if RP23XX_INFINEON_CYW43439 && ARCH_BOARD_PIMORONI_PICO_2_PLUS_W

config CYW43439_FIRMWARE_BIN_PATH
	string "Path to Infineon 43439 firmware file"
	default "${TOPDIR}/boards/arm/rp23xx/pimoroni-pico-2-plus-w/firmware/43439A0-7.95.49.00.combined"
	---help---
		This should be a path to a file containing both the cyw43439 firmware and
		the CLB blob.  The firmware should be padded to a 256 byte boundary and
		then the CLM blob should be appended.

		The firmware is vendored in-tree (see the path above) so the build
		needs no external pico-sdk/cyw43-driver checkout or PICO_SDK_PATH.

		If this file is updated, check the CYW43439_FIRMWARE_LEN below to make sure
		it reflects the un-padded length of the firmware part.

config CYW43439_FIRMWARE_LEN
	int "Infineon 43439 firmware length (bytes)"
	default 224190
	---help---
		This is the length of just the base firmware in the firmware file specified
		by the "Path to Infineon 43439 firmware file" configuration option.

		This length does not include the length of any padding nor the length of
		the appended clm_blob. If a clm_blob is present in the firmware file, this
		length will be less than the length of the whole file.

endif
```
